## Device_Firmware/POD/firmware/sdkconfig.defaults
```kconfig
# POD Firmware — sdkconfig.defaults
# Target
CONFIG_IDF_TARGET="esp32s3"

# Flash & PSRAM
CONFIG_ESPTOOLPY_FLASHSIZE_8MB=y
CONFIG_SPIRAM=y
CONFIG_SPIRAM_MODE_OCT=y
CONFIG_SPIRAM_SPEED_80M=y
CONFIG_SPIRAM_USE_MALLOC=y
CONFIG_SPIRAM_MALLOC_ALWAYSINTERNAL=16384

# Partition table
CONFIG_PARTITION_TABLE_CUSTOM=y
CONFIG_PARTITION_TABLE_CUSTOM_FILENAME="partitions.csv"
CONFIG_PARTITION_TABLE_OFFSET=0x8000

# OTA
CONFIG_BOOTLOADER_APP_ROLLBACK_ENABLE=y

# FreeRTOS
CONFIG_FREERTOS_HZ=1000
CONFIG_FREERTOS_UNICORE=n

# Logging
CONFIG_LOG_DEFAULT_LEVEL_INFO=y
CONFIG_LOG_MAXIMUM_LEVEL_DEBUG=y

# WiFi
CONFIG_ESP_WIFI_STATIC_RX_BUFFER_NUM=16
CONFIG_ESP_WIFI_DYNAMIC_RX_BUFFER_NUM=64
CONFIG_ESP_WIFI_TX_BUFFER_TYPE_DYNAMIC=y

# LWIP
CONFIG_LWIP_MAX_SOCKETS=16
CONFIG_LWIP_TCP_SND_BUF_DEFAULT=65535
CONFIG_LWIP_TCP_WND_DEFAULT=65535

# HTTP client / WebSocket
CONFIG_ESP_HTTP_CLIENT_ENABLE_HTTPS=y
CONFIG_WS_TRANSPORT_MAX_CONTROL_FRAME_BUFFER_LEN=256
CONFIG_WEBSOCKET_URI_DEFAULT_PORT_SECURE=8010

# MbedTLS
CONFIG_MBEDTLS_CERTIFICATE_BUNDLE=y
CONFIG_MBEDTLS_CERTIFICATE_BUNDLE_DEFAULT_FULL=y

# NVS encryption disabled (enable in production if desired)
CONFIG_NVS_ENCRYPTION=n

# ESP-SR wake word — Hi ESP
CONFIG_SR_WN_WN9_HIESP=y
CONFIG_SR_MODEL_WN9_HIESP=y
CONFIG_USE_WAKENET=y
CONFIG_USE_AFE=y
CONFIG_AFE_INTERFACE_V1=y

# Audio pipeline buffer
CONFIG_AFE_RINGBUF_SIZE=50

# Stack sizes (bytes)
CONFIG_ESP_MAIN_TASK_STACK_SIZE=8192

# LVGL — built via component manager, no lv_conf.h in SDK path
# (lv_conf.h is provided by display_bsp component)
```
